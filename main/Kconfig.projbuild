## main/Kconfig.projbuild
```kconfig
menu "Device Configuration"

    config ESP_WIFI_SSID
        string "WiFi SSID"
        default "your_ssid"
        help
            SSID of the WiFi network to connect to

    config ESP_WIFI_PASSWORD
        string "WiFi Password"
        default "your_password"
        help
            Password of the WiFi network to connect to

    config ESP_TELEGRAM_TOKEN
        string "Telegram Bot Token"
        default "your_token"
        help
            Token of the Telegram bot to use for sending messages

    config ESP_TELEGRAM_CHAT_ID
        string "Telegram Chat ID"
        default "CHAT ID"
        help
            Chat ID of the recipient group

endmenu
```
